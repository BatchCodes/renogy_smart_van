## components/renogy_ble/Kconfig
```kconfig
# SPDX-License-Identifier: GPL-3.0-or-later
menu "Renogy BT-2"

    config RENOGY_BLE_NAME_PREFIX
        string "BT-2 name prefix"
        default "BT-TH-"
        help
            The source connects to the first device whose BLE name starts with
            this text. The BT-2 advertises a name like "BT-TH-B00FXXXX".

    config RENOGY_BLE_MAC_ADDRESS
        string "BT-2 MAC address (optional)"
        default ""
        help
            Connect only to this BT-2, for example "80:6F:B0:0F:12:34". Leave it
            empty to connect to the first BT-2 found. Set it if other vans with a
            BT-2 can be near, for example at a campsite. The source logs the
            address of each BT-2 it finds.

    config RENOGY_BLE_DEVICE_ID
        int "Modbus device ID"
        range 1 255
        default 255
        help
            255 reaches the charger that is directly connected to the BT-2. Change
            it only for a hub or a daisy chain of Renogy devices.

    config RENOGY_BLE_POLL_INTERVAL_S
        int "Poll interval (seconds)"
        range 1 3600
        default 5
        help
            Time between two reads of the charger values.

    config RENOGY_BLE_RESPONSE_TIMEOUT_MS
        int "Response timeout (milliseconds)"
        range 500 30000
        default 3000

    config RENOGY_BLE_LOG_ALL_DEVICES
        bool "Log every named BLE device found"
        default n
        help
            Logs the name and RSSI of each named device in the scan, not only the
            BT-2. Use it to check that BLE works, or to find the BT-2 name.

    config RENOGY_BLE_MAX_FAILED_READS
        int "Disconnect after this many failed reads in a row"
        range 1 100
        default 3

endmenu
```

## firmware/cab_dash/main/Kconfig.projbuild
```kconfig
# SPDX-License-Identifier: GPL-3.0-or-later
menu "Cab dashboard"

    choice CAB_DASH_MODE
        prompt "Screen"
        default CAB_DASH_MODE_DASHBOARD
        help
            Dashboard: the charging dashboard.
            Test screen: the board bring-up screen with a tap counter and a colour
            bar. Use it to check the display, the rotation and the touch input.
            Camera test: the camera screen only, with frame rate logs. Use it to
            check the USB capture adapter.

        config CAB_DASH_MODE_DASHBOARD
            bool "Dashboard"
        config CAB_DASH_MODE_TEST_SCREEN
            bool "Test screen"
        config CAB_DASH_MODE_CAMERA_TEST
            bool "Camera test"
    endchoice

    choice CAB_DASH_CAMERA_RESOLUTION
        prompt "Camera resolution"
        default CAB_DASH_CAMERA_640X480
        help
            The MJPEG resolution to ask the USB capture adapter for. List the
            adapter's formats on a PC with "v4l2-ctl --list-formats-ext". A PAL
            camera gives 720 x 576.

        config CAB_DASH_CAMERA_640X480
            bool "640 x 480"
        config CAB_DASH_CAMERA_720X480
            bool "720 x 480"
        config CAB_DASH_CAMERA_720X576
            bool "720 x 576 (PAL)"
    endchoice

    config CAB_DASH_CAMERA_WIDTH
        int
        default 720 if CAB_DASH_CAMERA_720X480 || CAB_DASH_CAMERA_720X576
        default 640

    config CAB_DASH_CAMERA_HEIGHT
        int
        default 576 if CAB_DASH_CAMERA_720X576
        default 480

    config CAB_DASH_BACKLIGHT_TIMEOUT_S
        int "Backlight off after no touch for (seconds, 0 = never)"
        range 0 86400
        default 300
        help
            The cab unit is on only when the engine runs. Turn the backlight off
            after this time with no touch, so it does not dazzle at night. A touch
            turns it on again.

    choice CAB_DASH_ROTATION
        prompt "Display rotation"
        default CAB_DASH_ROTATION_90
        help
            The panel is 480 x 800 portrait. The dashboard is landscape. Select
            270 degrees if the image is upside down on your mounting.

        config CAB_DASH_ROTATION_90
            bool "90 degrees"
        config CAB_DASH_ROTATION_270
            bool "270 degrees"
    endchoice

    choice CAB_DASH_SOURCE
        prompt "Data source"
        default CAB_DASH_SOURCE_FAKE
        help
            Fake: simulated values, for testing the dashboard with no BT-2.
            Renogy BT-2: live values from the charger, through BLE on the C6. Set
            the BLE options in the "Renogy BT-2" menu.

        config CAB_DASH_SOURCE_FAKE
            bool "Fake data"
        config CAB_DASH_SOURCE_BT2
            bool "Renogy BT-2"
    endchoice

    config CAB_DASH_POLL_INTERVAL_MS
        int "Data poll interval (milliseconds)"
        range 100 60000
        default 1000
        help
            How often the data task asks the source for a new reading. The BT-2
            source reads the charger at its own poll interval.

    config CAB_DASH_STALE_AFTER_S
        int "Show the data age after (seconds)"
        range 1 86400
        default 30

    config CAB_DASH_OFFLINE_AFTER_S
        int "Show offline after (seconds)"
        range 1 86400
        default 120

    config CAB_DASH_BRIGHTNESS_PERCENT
        int "Backlight brightness (percent)"
        range 5 100
        default 80

endmenu
```

## firmware/rear_eink/main/Kconfig.projbuild
```kconfig
# SPDX-License-Identifier: GPL-3.0-or-later
menu "Rear e-paper display"

    choice REAR_EINK_MODE
        prompt "Display mode"
        default REAR_EINK_MODE_CHARGING
        help
            Charging data: the normal display. Until the BT-2 source exists, the
            data comes from the fake source, which simulates a short day with an
            outage, so every screen state appears.

            Test pattern: draws a fixed pattern and a counter, and logs the refresh
            times. Use it to bring up a new board or panel.

        config REAR_EINK_MODE_CHARGING
            bool "Charging data"
        config REAR_EINK_MODE_TEST_PATTERN
            bool "Test pattern"
    endchoice

    choice REAR_EINK_PANEL_MODEL
        prompt "Panel model"
        default REAR_EINK_PANEL_AUTO
        help
            Heltec Wireless Paper hardware version. Auto detection tells V1.1 and
            V1.1.1/V1.2 apart. V1.0 cannot be detected, so select it here.

        config REAR_EINK_PANEL_AUTO
            bool "Auto detect (V1.1 or V1.1.1/V1.2)"
        config REAR_EINK_PANEL_V1_0
            bool "Heltec V1.0 (SSD1680, DEPG0213BNS800)"
        config REAR_EINK_PANEL_V1_1
            bool "Heltec V1.1 (JD79656, LCMEN2R13EFC1, green film)"
        config REAR_EINK_PANEL_V1_2
            bool "Heltec V1.1.1 or V1.2 (SSD1682, E0213A367)"
    endchoice

    choice REAR_EINK_ROTATION
        prompt "Display rotation"
        default REAR_EINK_ROTATION_270
        help
            Turn the image by 180 degrees if it is upside down on your mounting.

        config REAR_EINK_ROTATION_90
            bool "90 degrees clockwise"
        config REAR_EINK_ROTATION_270
            bool "270 degrees clockwise"
    endchoice

    menu "Panel pins"
        config REAR_EINK_PIN_SCK
            int "SCK GPIO"
            default 3
        config REAR_EINK_PIN_MOSI
            int "MOSI GPIO"
            default 2
        config REAR_EINK_PIN_CS
            int "CS GPIO"
            default 4
        config REAR_EINK_PIN_DC
            int "DC GPIO"
            default 5
        config REAR_EINK_PIN_RST
            int "RST GPIO"
            default 6
        config REAR_EINK_PIN_BUSY
            int "BUSY GPIO"
            default 7
        config REAR_EINK_PIN_POWER
            int "Panel power GPIO (-1 if not switched)"
            default 45
            help
                Vext on the Heltec Wireless Paper.
        config REAR_EINK_POWER_ACTIVE_LOW
            bool "Panel power pin is active low"
            default y
    endmenu

    config REAR_EINK_REFRESH_INTERVAL_S
        int "Refresh interval (seconds)"
        range 1 3600
        default 5
        help
            Time between two display updates. The test default is 5 s. Use a
            longer interval in normal use, to save power and panel wear.

    config REAR_EINK_STALE_AFTER_S
        int "Show the data age after (seconds)"
        range 1 86400
        default 30
        help
            When the newest reading is older than this, the display shows its age.

    config REAR_EINK_OFFLINE_AFTER_S
        int "Show offline after (seconds)"
        range 1 86400
        default 120
        help
            When the newest reading is older than this, the display shows the
            offline screen.

    config REAR_EINK_MAX_UNCHANGED_S
        int "Full refresh of an unchanged image after (seconds)"
        range 60 86400
        default 3600
        help
            The display refreshes only when the image changes. It also does a full
            refresh after this time with no change, to keep the image clean.

    config REAR_EINK_FULL_REFRESH_EVERY
        int "Full refresh after this many fast refreshes"
        range 1 1000
        default 20
        help
            Fast refreshes leave some ghosting. A full refresh removes it, but the
            panel flashes.

endmenu
```

## tests/host/sdkconfig.defaults
```kconfig
# SPDX-License-Identifier: GPL-3.0-or-later
CONFIG_IDF_TARGET="linux"
CONFIG_IDF_TARGET_LINUX=y
CONFIG_UNITY_ENABLE_IDF_TEST_RUNNER=n
```
